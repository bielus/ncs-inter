## prj.conf
```kconfig
CONFIG_GPIO=y

# Enable MCUboot
CONFIG_BOOTLOADER_MCUBOOT=y

# Enable mcumgr DFU in application
CONFIG_MCUMGR=y

# Enable MCUMGR management for both OS and Images
CONFIG_MCUMGR_GRP_OS=y
CONFIG_MCUMGR_GRP_IMG=y

# Configure MCUMGR transport to UART
CONFIG_MCUMGR_TRANSPORT_UART=y

# Dependencies
# Configure dependencies for CONFIG_MCUMGR  
CONFIG_NET_BUF=y
CONFIG_ZCBOR=y
CONFIG_CRC=y

# Configure dependencies for CONFIG_MCUMGR_GRP_IMG  
CONFIG_FLASH=y
CONFIG_IMG_MANAGER=y

# Configure dependencies for CONFIG_IMG_MANAGER  
CONFIG_STREAM_FLASH=y
CONFIG_FLASH_MAP=y

# Configure dependencies for CONFIG_MCUMGR_TRANSPORT_UART 
CONFIG_BASE64=y

# Step 4.3 - Enable USB subsystem
CONFIG_USB_DEVICE_STACK=y
CONFIG_UART_LINE_CTRL=y
CONFIG_USB_DEVICE_INITIALIZE_AT_BOOT=n
```

## boards/nrf54l15dk_nrf54l15_cpuapp_ns.conf
```kconfig
# The nRF54L15DK does not have USB
CONFIG_USB_DEVICE_STACK=n
```

## boards/nrf54l15dk_nrf54l15_cpuapp.overlay
```dts
/*  app.overlay will be ignored when a boards overlay file is used. */

/ {
  chosen {
    nordic,pm-ext-flash = &mx25r64;
  };
};

&mx25r64 {
  status = "okay";
};
```

## src/main.c
```c
/*
 * Copyright (c) 2016 Intel Corporation
 *
 * SPDX-License-Identifier: Apache-2.0
 */

#include <zephyr/kernel.h>
#include <zephyr/drivers/gpio.h>

/* STEP 4.4 - Include header for usb */
#if CONFIG_USB_DEVICE_STACK
#include <zephyr/usb/usb_device.h>
#endif

/* 1000 msec = 1 sec */

/* STEP 2.4 - Change LED timing to create a new image for DFU */
#define SLEEP_TIME_MS   1000

/* The devicetree node identifier for the "led0" alias. */
#define LED0_NODE DT_ALIAS(led0)

/*
 * A build error on this line means your board is unsupported.
 * See the sample documentation for information on how to fix this.
 */
static const struct gpio_dt_spec led = GPIO_DT_SPEC_GET(LED0_NODE, gpios);

int main(void)
{
	int ret;

  /* Step 4.5 - Enable USB */
#if CONFIG_USB_DEVICE_STACK
		ret = usb_enable(NULL);
		if (ret) {
			return 0;
		}
#endif
	if (!device_is_ready(led.port)) {
		return 0;
	}

	ret = gpio_pin_configure_dt(&led, GPIO_OUTPUT_ACTIVE);
	if (ret < 0) {
		return 0;
	}

	while (1) {
		ret = gpio_pin_toggle_dt(&led);
		if (ret < 0) {
			return 0;
		}
		k_msleep(SLEEP_TIME_MS);
	}
  return 1;
}
```
