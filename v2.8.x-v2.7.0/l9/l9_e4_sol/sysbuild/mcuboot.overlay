
/* Configure button and LED for Serial Recovery */
/ {
  aliases {
		mcuboot-button0 = &button1;
		mcuboot-led0 = &led1;
  };
};

/* Step 2.2 - Configure CDC_ACM */
&zephyr_udc0 {
	cdc_acm_uart0: cdc_acm_uart0 {
		compatible = "zephyr,cdc-acm-uart";
	};
};


/* Step 8.1 - Add external flash */

